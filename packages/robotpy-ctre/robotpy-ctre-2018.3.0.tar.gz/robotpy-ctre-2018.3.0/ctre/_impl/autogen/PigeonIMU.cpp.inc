/**
    This file is autogenerated
*/

{
  py::class_<PigeonIMU> cls(m, "PigeonIMU");
  cls.def(py::init<>())
    .def("_create2", &PigeonIMU::_create2, py::arg("talonDeviceID"), release_gil())
    .def("_create1", &PigeonIMU::_create1, py::arg("deviceNumber"), release_gil())
    .def("setYaw", &PigeonIMU::setYaw, py::arg("angleDeg"), py::arg("timeoutMs"), release_gil())
    .def("addYaw", &PigeonIMU::addYaw, py::arg("angleDeg"), py::arg("timeoutMs"), release_gil())
    .def("setYawToCompass", &PigeonIMU::setYawToCompass, py::arg("timeoutMs"), release_gil())
    .def("setFusedHeading", &PigeonIMU::setFusedHeading, py::arg("angleDeg"), py::arg("timeoutMs"), release_gil())
    .def("addFusedHeading", &PigeonIMU::addFusedHeading, py::arg("angleDeg"), py::arg("timeoutMs"), release_gil())
    .def("setFusedHeadingToCompass", &PigeonIMU::setFusedHeadingToCompass, py::arg("timeoutMs"), release_gil())
    .def("setAccumZAngle", &PigeonIMU::setAccumZAngle, py::arg("angleDeg"), py::arg("timeoutMs"), release_gil())
    .def("configTemperatureCompensationEnable", &PigeonIMU::configTemperatureCompensationEnable, py::arg("bTempCompEnable"), py::arg("timeoutMs"), release_gil())
    .def("setCompassDeclination", &PigeonIMU::setCompassDeclination, py::arg("angleDegOffset"), py::arg("timeoutMs"), release_gil())
    .def("setCompassAngle", &PigeonIMU::setCompassAngle, py::arg("angleDeg"), py::arg("timeoutMs"), release_gil())
    .def("enterCalibrationMode", &PigeonIMU::enterCalibrationMode, py::arg("calMode"), py::arg("timeoutMs"), release_gil())
    .def("getGeneralStatus", &PigeonIMU::getGeneralStatus, release_gil())
    .def("getLastError", &PigeonIMU::getLastError, release_gil())
    .def("get6dQuaternion", &PigeonIMU::get6dQuaternion, release_gil())
    .def("getYawPitchRoll", &PigeonIMU::getYawPitchRoll, release_gil())
    .def("getAccumGyro", &PigeonIMU::getAccumGyro, release_gil())
    .def("getAbsoluteCompassHeading", &PigeonIMU::getAbsoluteCompassHeading, release_gil())
    .def("getCompassHeading", &PigeonIMU::getCompassHeading, release_gil())
    .def("getCompassFieldStrength", &PigeonIMU::getCompassFieldStrength, release_gil())
    .def("getTemp", &PigeonIMU::getTemp, release_gil())
    .def("getState", &PigeonIMU::getState, release_gil())
    .def("getUpTime", &PigeonIMU::getUpTime, release_gil())
    .def("getRawMagnetometer", &PigeonIMU::getRawMagnetometer, release_gil())
    .def("getBiasedMagnetometer", &PigeonIMU::getBiasedMagnetometer, release_gil())
    .def("getBiasedAccelerometer", &PigeonIMU::getBiasedAccelerometer, release_gil())
    .def("getRawGyro", &PigeonIMU::getRawGyro, release_gil())
    .def("getAccelerometerAngles", &PigeonIMU::getAccelerometerAngles, release_gil())
    .def("_getFusedHeading2", &PigeonIMU::_getFusedHeading2, release_gil())
    .def("_getFusedHeading1", &PigeonIMU::_getFusedHeading1, release_gil())
    .def("getResetCount", &PigeonIMU::getResetCount, release_gil())
    .def("getResetFlags", &PigeonIMU::getResetFlags, release_gil())
    .def("getFirmwareVersion", &PigeonIMU::getFirmwareVersion, release_gil())
    .def("hasResetOccurred", &PigeonIMU::hasResetOccurred, release_gil())
    .def("setLastError", &PigeonIMU::setLastError, py::arg("value"), release_gil())
    .def("getFaults", &PigeonIMU::getFaults, release_gil())
    .def("getStickyFaults", &PigeonIMU::getStickyFaults, release_gil())
    .def("clearStickyFaults", &PigeonIMU::clearStickyFaults, py::arg("timeoutMs"), release_gil())
    .def("setStatusFramePeriod", &PigeonIMU::setStatusFramePeriod, py::arg("frame"), py::arg("periodMs"), py::arg("timeoutMs"), release_gil())
    .def("getStatusFramePeriod", &PigeonIMU::getStatusFramePeriod, py::arg("frame"), py::arg("timeoutMs"), release_gil())
    .def("setControlFramePeriod", &PigeonIMU::setControlFramePeriod, py::arg("frame"), py::arg("periodMs"), release_gil())
  ;
}